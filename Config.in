## Config.in
```kconfig
source "../package/cloop/Config.in"
source "../package/ubuntugrub/Config.in"
source "../package/ms-sys/Config.in"
source "../package/reged/Config.in"
source "../package/reiserfsprogs/Config.in"
```
